// SPDX-License-Identifier: GPL-2.0-only
/*
 * v032 BOARD CLOCK-ROLE EXPERIMENT. Do not include in a deployable image until the
 * GPIO/pinmux handoff and regulator wiring have been qualified.
 * The Bluetooth serial child is DISABLED by design for static DT checks.
 * Existing WLAN regulator owner, MMC pwrseq and kernel boot are unchanged.
 */
&uartc {
    bluetooth {
        compatible = "motorola,stingray-bcm4329-bt",
                     "brcm,bcm4329-bt";
        motorola,shared-u4-power;
        shared-supply = <&reg_wifi_vdd>;

        /* Tegra PMC CLK_BLINK is 32.768 kHz: this is Broadcom LPO,
         * not the normal-frequency TXCO reference oscillator.
         * The external crystal/ref-clock is NOT modeled here until
         * Motorola board provenance is verified.
         */
        clocks = <&tegra_pmc TEGRA_PMC_CLK_BLINK>;
        clock-names = "lpo";

        status = "disabled";
    };
};
